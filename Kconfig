## Kconfig
```kconfig
DT_COMPAT_ZMK_CYCLOTAB := zmk,cyclotab
DT_COMPAT_ZMK_BEHAVIOR_CYCLOTAB_LAYER := zmk,behavior-cyclotab-layer
DT_COMPAT_ZMK_BEHAVIOR_CYCLOTAB_REVERSE := zmk,behavior-cyclotab-reverse
DT_COMPAT_ZMK_BEHAVIOR_CYCLOTAB_ENCODER := zmk,behavior-cyclotab-encoder
DT_COMPAT_ZMK_BEHAVIOR_CYCLOTAB_MODE := zmk,behavior-cyclotab-mode
DT_COMPAT_ZMK_BEHAVIOR_SMOOTH_SCROLL := zmk,behavior-smooth-scroll

config ZMK_CYCLOTAB
    bool
    default $(dt_compat_enabled,$(DT_COMPAT_ZMK_CYCLOTAB)) || $(dt_compat_enabled,$(DT_COMPAT_ZMK_BEHAVIOR_CYCLOTAB_LAYER)) || $(dt_compat_enabled,$(DT_COMPAT_ZMK_BEHAVIOR_CYCLOTAB_REVERSE)) || $(dt_compat_enabled,$(DT_COMPAT_ZMK_BEHAVIOR_CYCLOTAB_ENCODER)) || $(dt_compat_enabled,$(DT_COMPAT_ZMK_BEHAVIOR_CYCLOTAB_MODE))

config ZMK_SMOOTH_SCROLL
    bool
    default $(dt_compat_enabled,$(DT_COMPAT_ZMK_BEHAVIOR_SMOOTH_SCROLL))

DT_COMPAT_ZMK_BEHAVIOR_UC_INDICATOR := zmk,behavior-uc-indicator

config ZMK_UC_INDICATOR
    bool
    default $(dt_compat_enabled,$(DT_COMPAT_ZMK_BEHAVIOR_UC_INDICATOR))
```

## dts/bindings/behaviors/zmk,behavior-cyclotab-encoder.yaml
```yaml
description: |
  Encoder for Cyclotab: each detent taps a hotkey directly (no behavior
  queue). keys = <cw ccw> pairs; with two pairs, &cyc_mode switches between
  them. The switch ends (selects) timeout-ms after the last detent.
compatible: "zmk,behavior-cyclotab-encoder"
properties:
  "#sensor-binding-cells":
    type: int
    required: true
    const: 0
  keys:
    type: array
    required: true
    description: e.g. <LA(TAB) LS(LA(TAB)) LC(TAB) LS(LC(TAB))>
  timeout-ms:
    type: int
    default: 600
```

## dts/bindings/behaviors/zmk,behavior-cyclotab-end.yaml
```yaml
description: |
  Ends a cyclotab cycle (releases the modifier, drops the layer) and swallows
  the key. Optionally sends a key first (e.g. ESC to cancel the switcher).
compatible: "zmk,behavior-cyclotab-end"
include: zero_param.yaml
properties:
  layer:
    type: int
    required: true
  send-key:
    type: int
    default: 0
    description: Optional keycode tapped before the modifier is released.
```

## dts/bindings/behaviors/zmk,behavior-cyclotab-enter.yaml
```yaml
description: |
  Activates the cyclotab layer (parameter = layer id) and drops it again if no
  cyclotab key is pressed within arm-timeout-ms. Tapping it again cancels.
compatible: "zmk,behavior-cyclotab-enter"
include: one_param.yaml
properties:
  arm-timeout-ms:
    type: int
    default: 1500
```

## dts/bindings/behaviors/zmk,behavior-cyclotab-layer.yaml
```yaml
description: |
  Tap to arm a switch layer (param = layer). A hotkey on that layer starts a
  cycle; the layer is dropped when the cycle ends, when any other key is
  pressed, or after arm-timeout-ms. Tapping it again while armed sends a
  plain tap-key (default TAB) instead.
compatible: "zmk,behavior-cyclotab-layer"
include: one_param.yaml
properties:
  arm-timeout-ms:
    type: int
    default: 1500
  tap-key:
    type: int
    default: 0x7002B
```

## dts/bindings/behaviors/zmk,behavior-cyclotab-mode.yaml
```yaml
description: |
  Toggles &cyc_enc between its first and second key pair (e.g. Alt+Tab and
  Ctrl+Tab). Resets to the first pair when the layer it was pressed on is released.
compatible: "zmk,behavior-cyclotab-mode"
include: zero_param.yaml
```

## dts/bindings/behaviors/zmk,behavior-cyclotab-reverse.yaml
```yaml
description: |
  During a Cyclotab cycle, sends the current hotkey with Shift added
  (previous window). Outside a cycle it only closes the armed switch layer.
compatible: "zmk,behavior-cyclotab-reverse"
include: zero_param.yaml
```

## dts/bindings/behaviors/zmk,behavior-cyclotab.yaml
```yaml
description: |
  Cyclotab: tap to press a modifier (e.g. Alt) and Tab. The modifier stays held
  after the tap so further taps keep cycling. Ended by cyclotab-end keys, by
  the timeout, or by switching to another cyclotab key.
compatible: "zmk,behavior-cyclotab"
include: zero_param.yaml
properties:
  modifier:
    type: int
    required: true
    description: Modifier keycode to hold, e.g. <LALT>, <LGUI>, <LCTRL>
  key:
    type: int
    required: true
    description: Keycode tapped on every press, e.g. <TAB>
  layer:
    type: int
    required: true
    description: Layer that is dropped when the cycle ends
  timeout-ms:
    type: int
    default: 1000
    description: Release the modifier this long after the last tap. 0 = no timeout.
```

## dts/bindings/behaviors/zmk,behavior-smooth-scroll.yaml
```yaml
description: |
  Smooth scroll encoder: detents become high-resolution wheel reports right
  away, spread over smooth-ms, with acceleration for fast turning.
compatible: "zmk,behavior-smooth-scroll"
properties:
  "#sensor-binding-cells":
    type: int
    required: true
    const: 0
  notch-percent:
    type: int
    default: 100
    description: Scroll per detent in percent of one mouse-wheel notch.
  smooth-ms:
    type: int
    default: 40
    description: Time over which one detent's scroll is spread.
  tick-ms:
    type: int
    default: 8
    description: Interval between the small wheel reports.
  acceleration-window-ms:
    type: int
    default: 150
    description: Detents closer than this get bigger. 0 = no acceleration.
  max-acceleration-percent:
    type: int
    default: 400
    description: Size of a detent at full speed, in percent.
  invert:
    type: boolean
    description: Clockwise scrolls up instead of down.
  horizontal:
    type: boolean
    description: Scroll sideways instead.
```

## dts/bindings/behaviors/zmk,behavior-uc-indicator.yaml
```yaml
description: |
  Unicode mode indicator: &uc_ind 0 = Windows, &uc_ind 1 = Linux. Global
  behavior (runs on both halves); the nice!view on the right half shows it.
compatible: "zmk,behavior-uc-indicator"
include: one_param.yaml
```

## dts/bindings/zmk,cyclotab.yaml
```yaml
description: |
  Cyclotab for ZMK (port of Pascal Getreuer's QMK Cyclotab).
  Any &kp binding that sends one of `keys` (e.g. LA(TAB)) starts a cycle: the
  modifier stays held after release, so further taps cycle through windows.
  The next other key press/release ends the cycle and is consumed.
compatible: "zmk,cyclotab"
properties:
  keys:
    type: array
    required: true
    description: Hotkeys, e.g. <LA(TAB) LS(LA(TAB)) LG(TAB) LS(LG(TAB))>
  timeout-ms:
    type: int
    default: 1000
    description: Release the mods this long after the last hotkey tap. 0 = never.
```
